## application/edge_agent/boards/waveshare/waveshare_esp32_s3_lcd_1_47b/sdkconfig.defaults.board
```kconfig
# Waveshare ESP32-S3-LCD-1.47B — ESP32-S3-WROOM-1-N16R8 (16 MB QIO flash + 8 MB Octal PSRAM)
# Source: Waveshare official ESP-IDF demo sdkconfig.defaults

CONFIG_ESP_DEFAULT_CPU_FREQ_MHZ_240=y

# Flash: 16 MB, QIO 80 MHz
CONFIG_ESPTOOLPY_FLASHMODE_QIO=y
CONFIG_ESPTOOLPY_FLASHFREQ_80M=y
CONFIG_ESPTOOLPY_FLASHSIZE_16MB=y

# Partition table for 16 MB flash
CONFIG_PARTITION_TABLE_CUSTOM=y
CONFIG_PARTITION_TABLE_CUSTOM_FILENAME="partitions_16MB.csv"

# PSRAM: 8 MB Octal (ESP32-S3R8), 80 MHz
CONFIG_SPIRAM=y
CONFIG_SPIRAM_MODE_OCT=y
CONFIG_SPIRAM_SPEED_80M=y

# Enable LCD display support
CONFIG_ESP_BOARD_DEV_DISPLAY_LCD_SUPPORT=y
CONFIG_APP_CLAW_LUA_MODULE_LCD=y

# Select QMI8658 as the IMU chip for this board
CONFIG_LUA_MODULE_IMU_CHIP_QMI8658=y
CONFIG_APP_CLAW_LUA_MODULE_IMU=y
```
